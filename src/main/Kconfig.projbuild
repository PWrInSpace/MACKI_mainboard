## src/main/Kconfig.projbuild
```kconfig
menu "MACKI v1.0 Mainboard Config"
    
    menu "Board GPIO pinout"
        config LED_GPIO
            int "Dummy led"
            default 0
            help
                Dummy so kconfig doesn't break
    endmenu
    
    menu "Logger configuration"

        config LOG_RECEIVERS_COUNT
            int "Number of log receivers"
            default 3
            help
                Number of log receivers present in software i.e. USB, UART, BLE

        config LOG_BUFFER_SIZE
            int "Size of log buffer - closely correlated to MAX_RING_BUFFER_SIZE"
            default 256
            help
                Size of log buffer (elements held)

        config LOG_TOTAL_CHAR_BUFFER_LEN
            int "Size of the maximum length of the log - post log processing"
            default 512
            help
                Size of the log char - string length

        config LOG_MESSAGE_CHAR_BUFFER_LEN
            int "Size of the maximum length of the log message - pre log processing"
            default 400
            help
                Size of the log message char - string length

        config LOG_TAG_CHAR_BUFFER_LEN
            int "Size of the maximum length of the log tag - pre log processing"
            default 32
            help
                Size of the log tag char - string length

        config MACKI_LOG_LEVEL
            int "Chosen log level. TRACE = 0, DEBUG, INFO, WARN, ERROR"
            default 2
            help
                Chosen log level for the project. Info by default
    
    endmenu

    menu "Utils configuration"

        config MAX_RING_BUFFER_SIZE
            int "Maximum ring buffer size"
            default 256
            help
                Specify the maximum number of elements the ring buffer can hold
            
    endmenu

endmenu
```

## src/test/main/Kconfig.projbuild
```kconfig
menu "MACKI v1.0 Mainboard Config"
    
    menu "Board GPIO pinout"
        config LED_GPIO
            int "Dummy led"
            default 0
            help
                Dummy so kconfig doesn't break
    endmenu
    
    menu "Logger configuration"

        config LOG_RECEIVERS_COUNT
            int "Number of log receivers"
            default 3
            help
                Number of log receivers present in software i.e. USB, UART, BLE

        config LOG_BUFFER_SIZE
            int "Size of log buffer - closely correlated to MAX_RING_BUFFER_SIZE"
            default 256
            help
                Size of log buffer (elements held)

        config LOG_TOTAL_CHAR_BUFFER_LEN
            int "Size of the maximum length of the log - post log processing"
            default 512
            help
                Size of the log char - string length

        config LOG_MESSAGE_CHAR_BUFFER_LEN
            int "Size of the maximum length of the log message - pre log processing"
            default 400
            help
                Size of the log message char - string length

        config LOG_TAG_CHAR_BUFFER_LEN
            int "Size of the maximum length of the log tag - pre log processing"
            default 32
            help
                Size of the log tag char - string length

        config MACKI_LOG_LEVEL
            int "Chosen log level. TRACE = 0, DEBUG, INFO, WARN, ERROR"
            default 2
            help
                Chosen log level for the project. Info by default
    
    endmenu

    menu "Utils configuration"

        config MAX_RING_BUFFER_SIZE
            int "Maximum ring buffer size"
            default 256
            help
                Specify the maximum number of elements the ring buffer can hold
            
    endmenu

    menu "GPIO configuration"

        config SD_MOSI_PIN_NUM
            int "SD card mosi pin number"
            default 41
            help
                SD card mosi pin number

        config SD_MISO_PIN_NUM
            int "SD card miso pin number"
            default 39
            help
                SD card miso pin number

        config SD_SCLK_PIN_NUM
            int "SD card sclk pin number"
            default 40
            help
                SD card sclk pin number

        config SD_CS_PIN_NUM
            int "SD card CS pin number"
            default 38
            help
                SD card CS pin number

        config SD_CD_PIN_NUM
            int "SD card CD pin number"
            default 0
            help
                SD card CD pin number

        config I2C_SCL_PIN_NUM
            int "I2C SCL pin number"
            default 7
            help
                I2C SCL pin number
        
        config I2C_SDA_PIN_NUM
            int "I2C SDA pin number"
            default 15
            help
                I2C SDA pin number
    
    endmenu

endmenu
```

## src/test/sdkconfig.defaults
```kconfig
CONFIG_BT_ENABLED=y
CONFIG_IDF_TARGET="esp32s3"

CONFIG_BT_BLE_50_FEATURES_SUPPORTED=n
CONFIG_BT_BLE_42_FEATURES_SUPPORTED=y
CONFIG_BT_LE_50_FEATURE_SUPPORT=n
CONFIG_TINYUSB_CDC_ENABLED=y
CONFIG_ESPTOOLPY_FLASHSIZE_8MB=y
CONFIG_ESPTOOLPY_FLASHSIZE_2MB=n

CONFIG_ESP_TASK_WDT_EN=n
CONFIG_ESP_INT_WDT=n
CONFIG_ESP_INT_WDT_CHECK_CPU1=n
CONFIG_ESP_TASK_WDT_EN=n
CONFIG_ESP_TASK_WDT_INIT=n
CONFIG_ESP_TASK_WDT_CHECK_IDLE_TASK_CPU0=n
CONFIG_ESP_TASK_WDT_CHECK_IDLE_TASK_CPU1=n

CONFIG_LOG_DEFAULT_LEVEL_NONE=y
CONFIG_LOG_DEFAULT_LEVEL=0
```
